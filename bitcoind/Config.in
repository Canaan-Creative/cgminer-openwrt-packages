## cgminer/Config.in
```kconfig
config CGMINER_AVALON1
	bool "Enable Avalon1(A3256) support"
	default n
config CGMINER_AVALON2
	bool "Enable Avalon2(A3255)/Avalon3(A3233) support"
	default n
config CGMINER_AVALON4
	bool "Enable Avalon4(A3222) support"
	default y
config CGMINER_AVALON6
	bool "Enable Avalon6(A3218) support"
	default n
config CGMINER_AVALON7
	bool "Enable Avalon7(A3212) support"
	default n
config CGMINER_AVALON8
	bool "Enable Avalon8(A3210) support"
	default n
config CGMINER_AVALON9
	bool "Enable Avalon9(A3206) support"
	default n
```

## mm-tools/Config.in
```kconfig
config MM_TOOLS_SOFT_CRC
	bool "Enable soft crc algorithm"
	default n
config MM_TOOLS_FLASH_LAYOUT_2M
	bool "Enable flash layout 2m"
	default n
```
